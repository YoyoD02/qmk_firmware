## keyboards/toutou68/toutou68_defconfig
```kconfig
# Copyright (c) 2021 Nick Winans
# SPDX-License-Identifier: MIT

CONFIG_SOC_SERIES_NRF52X=y
CONFIG_SOC_NRF52840_QIAA=y
CONFIG_BOARD_TOUTOU68=y

# Enable MPU
CONFIG_ARM_MPU=y

# enable GPIO
CONFIG_GPIO=y
CONFIG_PINCTRL=y

CONFIG_USE_DT_CODE_PARTITION=y
CONFIG_BUILD_OUTPUT_UF2=y

# eable flash
CONFIG_MPU_ALLOW_FLASH_WRITE=y
CONFIG_NVS=y
CONFIG_SETTINGS_NVS=y
CONFIG_FLASH=y
CONFIG_FLASH_PAGE_LAYOUT=y
CONFIG_FLASH_MAP=y 

# enable RGB
CONFIG_ZMK_RGB_UNDERGLOW=y
CONFIG_WS2812_STRIP=y

CONFIG_ZMK_RGB_UNDERGLOW_HUE_START=160
CONFIG_ZMK_RGB_UNDERGLOW_EFF_START=3

CONFIG_ZMK_USB=y
CONFIG_ZMK_BLE=y

#Turn off RGB underglow when keyboard goes into idle state
CONFIG_ZMK_RGB_UNDERGLOW_AUTO_OFF_IDLE=y

#Enable the Bluetooth BAS (battery reporting service)
CONFIG_BT_BAS=y

# resolved connection interruption issue
CONFIG_CLOCK_CONTROL_NRF=y
CONFIG_CLOCK_CONTROL_NRF_K32SRC_RC=y

# new added in toutou68 compared with nice60

# enable idle
# CONFIG_ZMK_SLEEP=y
CONFIG_ZMK_RGB_UNDERGLOW_ON_START=y
CONFIG_SPI=y
#nkro
#CONFIG_ZMK_HID_REPORT_TYPE_NKRO=y 

#Low level setting for GATT subscriptions. Set to n to work around an annoying Windows bug with battery notifications
#CONFIG_BT_GATT_ENFORCE_SUBSCRIPTION=n

# bluetooth  Increasing the transmit power of the keyboard's BLE radio
CONFIG_BT_CTLR_TX_PWR_PLUS_8=y
```
